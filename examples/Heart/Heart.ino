/**
 * "Сердечко".
 * размер скетча 654 байт, SRAM = 14 байт.
 *
 * Аппаратное, плавное управление яркостью (ШИМ - широтно-импульсная модуляция, PWM)
 * Изменяем яркость на светодиоде за счет изменения ширины (длительности) импульса (1)
 * и его паузы (0) при одной и той же тактовой частоте следования импульсов (тут стандартно 490гц.)
 *
 * "Сердечный ритм" задается последовательностью предельных значений яркости (массив starts)
 * и набором шагов (скорости) изменения яркости (ширины импульсов). На каждой стадии цикла
 * из массива starts[] выбираются 2 соседних элемента для определения "начала" и "конца" стадии.
 *
 * Примечание:
 * поскольку чиселки небольшие, то крайние значения надо выбирать так, чтобы добавляя или убавляя
 * шаг не выйти через переполнение. В противном случае, цикл не остановится и контрольный светодиод
 * мигать в конце всех стадий - НЕ БУДЕТ.
 *
 * @author Arhat109 arhat109@mail.ru, +7-(951)-388-2793
 * 
 * Лицензия:
 * 1. Полностью свободное и бесплатное программное обеспечение. В том числе и от претензий.
 * 2. Вы вправе использовать его на свои нужды произвольным образом и на свой риск.
 * 3. Вы не вправе удалять из него строку с тегом @author или изменять её.
 * 4. Изменяя этот файл, Вы вправе дописать свои авторские данные и/или пояснения.
 * 
 * Если Вам это оказалось полезным, то Вы можете по-достоинству оценить мой труд
 * "на свое усмотрение" (напр. кинуть денег на телефон "сколько не жалко")
 */

#define _ARHAT_   1             // режим минимального кода
#include "arhat.h"

#define pinHeart        pin4    // нога со светодиодом для плавного управления яркостью
#define waitStep         30     // миллисекунд на 1 шаг изменения яркости
#define waitCycle       160     // миллисекунд паузы между повторением

// пределы яркости: каждая пара соседних чисел: "от".."до"
// сначала плавно растим яркость от 10 до 240, затем гасим от 240 до 20,
// снова увеличиваем от 20 до 230 и потом уменьшаем от 230 до 10
// ... и далее "по кругу"
uint8_t        starts[] = {10,240,20,230,10};

// скорость изменения яркости: шагов меньше на один чем пределов!
#define maxSteps   4
uint8_t        steps[] = {15,20,15,20};

void setup() {
  pinMode(pinLed, OUTPUT);      // контрольная 13 нога (встроенный светодиод)
  pwmSet(pinHeart);             // включаем 6-ю ногу в режим ШИМ (PWM)
}

void loop() {
  uint8_t     i,j;  // объявляем счетчики: стадий мигания и шага изменения яркости

  // поскольку все счетчики и пределы - беззнаковые, то делаем 2 отдельных цикла:
  
  for(i=0; i<maxSteps; i++ ){                           // перебираем стадии мигания
    if( starts[i+1]>starts[i] ){                        // если яркость увеличиваем:
      for(j=starts[i]; j<starts[i+1]; j+=steps[i] ){    // вычисляем текущую яркость шага
        analogWrite(pinHeart, j);                       // изменяем ШИМ
        delay(waitStep);
      }
    }else{                                              // нет: надо уменьшать яркость:
      for(j=starts[i]; j>starts[i+1]; j-=steps[i]) {    // вычисляем яркость уменьшением на шаг
        analogWrite(pinHeart, j);
        delay(waitStep);
      }
    }
  }
  digitalWrite(pinLed, HIGH);                           // контрольное мигание 13 ногой.
  delay(waitCycle);
  digitalWrite(pinLed, LOW);
}
